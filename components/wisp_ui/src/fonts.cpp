#include "wisp/ui/fonts.hpp"

#include <algorithm>
#include <atomic>
#include <cassert>
#include <cstdint>
#include <memory>
#include <utility>
#include <vector>

#include "a8_font.hpp"
#include "fonts_internal.hpp"
#include "wisp/core/log.hpp"
#include "wisp/ui/font_image.hpp"
#include "wisp/ui/glyph_image.hpp"

#if !LV_USE_TINY_TTF
#error "the font service needs LV_USE_TINY_TTF (components/wisp_ui/config/lv_conf.h)"
#endif

// lv_font_cjk_16.c and lv_font_wisp_icons_*.c are plain C translation
// units (generated by tools/gen_cjk_font.py and tools/gen_icon_font.py),
// so their exported symbols have C linkage. lv_font_cjk_16 is compiled in
// on the host only (WISP_UI_BUILTIN_CJK16, components/wisp_ui/
// CMakeLists.txt); the firmware reads the same font from the glyphs
// partition instead (glyph-partition spec 3.3).
extern "C" {
#ifdef WISP_UI_BUILTIN_CJK16
extern const lv_font_t lv_font_cjk_16;
#endif
extern const lv_font_t lv_font_wisp_icons_16;
extern const lv_font_t lv_font_wisp_icons_24;
extern const lv_font_t lv_font_wisp_icons_32;
extern const lv_font_t lv_font_wisp_icons_48;
}

namespace wisp::ui {

namespace {

// The body font's CJK fallback while no runtime has chosen one: the
// built-in font where there is one, else none.
const lv_font_t* idle_cjk_fallback() {
#ifdef WISP_UI_BUILTIN_CJK16
    return &lv_font_cjk_16;
#else
    return nullptr;
#endif
}

// The body font's chain is Montserrat (Latin and the LV_SYMBOL_* icons),
// then the 16 px Wisp icons (wisp/ui/symbols.hpp), then the CJK font.
// The fonts are `const`, so these are mutable copies, each with its
// `fallback` set. Function-local statics: constructed exactly
// once (C++11 magic statics are thread-safe), the first time anyone
// (UiRuntime::start() or an outside caller, e.g. wisp_app's self-check
// UI) asks for the body font.
lv_font_t& icons_base() {
    static lv_font_t s_base = [] {
        lv_font_t font = lv_font_wisp_icons_16;
        font.fallback = idle_cjk_fallback();
        return font;
    }();
    return s_base;
}

lv_font_t& body_base() {
    static lv_font_t s_base = [] {
        lv_font_t font = lv_font_montserrat_16;
        font.fallback = &icons_base();
        return font;
    }();
    return s_base;
}

}  // namespace

const lv_font_t* default_font() {
    // Drawn from cached 8-bit glyphs rather than expanded on every draw
    // (see a8_font.hpp); pixels are the same. The pointer never changes,
    // since themes, styles and the icon and vector fonts' fallbacks hold
    // it; set_cjk_fallback() rewires what it falls back to instead.
    static const lv_font_t* s_ui_font = a8_font(&body_base());
    return s_ui_font;
}

namespace {

// The vector fonts by index in kFontSteps: nullptr until font() first
// asks for that step, then either the Tiny TTF font (also kept in
// s_vector, which owns it) or the bitmap font that stands in for it.
// Both tables and the image are touched only on the UI thread, or by
// UiRuntime::start()/stop() while no UI task runs.
std::array<const lv_font_t*, kFontSteps.size()> s_fonts{};
std::array<lv_font_t*, kFontSteps.size()> s_vector{};
FontImage s_image;
// The UI task while a runtime runs, for the debug-build check in font().
std::atomic<const os::Task*> s_owner{nullptr};

// Tiny TTF's own glyph lookup, which vector_glyph_dsc() wraps. The same
// function for every Tiny TTF font.
bool (*s_tiny_ttf_glyph_dsc)(const lv_font_t*, lv_font_glyph_dsc_t*, uint32_t, uint32_t) = nullptr;
// The 16 px vector font standing in for a missing glyph image (spec 4.3),
// owned here like s_vector's fonts; nullptr when not in use.
lv_font_t* s_body_vector = nullptr;

// A font built from a glyph image, with the bytes it was built from.
struct KeptGlyphFont {
    const uint8_t* data;
    size_t size;
    std::unique_ptr<GlyphFont> font;
};

// Every glyph font a runtime has used. Never freed: a8_font() keeps a
// wrapper keyed by the font's address for the life of the process, so a
// freed font could come back at the same address under a stale wrapper.
// A restart with the same bytes reuses its font, so the list grows only
// when the bytes do change. Deliberately leaked, so no exit-time
// destructor runs either.
std::vector<KeptGlyphFont>& kept_glyph_fonts() {
    static auto* list = new std::vector<KeptGlyphFont>();
    return *list;
}

// The kept font for these bytes, or `opened` kept as a new one. A font
// whose bytes match an earlier one (same place, size and CRC) is
// dropped unused, which is safe as it has never been wrapped.
const GlyphFont* keep_glyph_font(std::span<const uint8_t> raw, std::unique_ptr<GlyphFont> opened) {
    for (const KeptGlyphFont& k : kept_glyph_fonts()) {
        if (k.data == raw.data() && k.size == raw.size() && k.font->crc32 == opened->crc32) {
            return k.font.get();
        }
    }
    kept_glyph_fonts().push_back({raw.data(), raw.size(), std::move(opened)});
    return kept_glyph_fonts().back().font.get();
}

// Points the body font at `cjk` for the characters Montserrat and the
// Wisp icons lack: the end of the chain, behind the icons.
void set_cjk_fallback(const lv_font_t* cjk) {
    // Wraps the chain first, so the icons' wrapper (if any) exists.
    const lv_font_t* body = default_font();
    // The copy is what an unwrapped chain reaches: a8_font() declined to
    // wrap Montserrat (whose copy then falls back to this one directly)
    // or the icon font.
    icons_base().fallback = cjk;
    const lv_font_t* icons = body == &body_base() ? &icons_base() : body->fallback;
    if (icons != &icons_base()) a8_set_fallback(icons, cjk);
}

// A copy of the icon font `base` falling back to the body fonts, drawn
// through the A8 cache; see default_font().
const lv_font_t* wrap_icons(lv_font_t& copy, const lv_font_t& base) {
    copy = base;
    copy.fallback = default_font();
    return a8_font(&copy);
}

// The icon font for a step: the largest of 24, 32 and 48 px not above it,
// none for 20 (spec 4.2). The vector font has no LV_SYMBOL_* or Wisp icons
// (they are FontAwesome's private-use code points), so icons come from here,
// and everything else it lacks falls through to the body fonts.
const lv_font_t* icon_font(int step) {
    if (step >= 48) {
        static lv_font_t s_base;
        static const lv_font_t* s_font = wrap_icons(s_base, lv_font_wisp_icons_48);
        return s_font;
    }
    if (step >= 32) {
        static lv_font_t s_base;
        static const lv_font_t* s_font = wrap_icons(s_base, lv_font_wisp_icons_32);
        return s_font;
    }
    if (step >= 24) {
        static lv_font_t s_base;
        static const lv_font_t* s_font = wrap_icons(s_base, lv_font_wisp_icons_24);
        return s_font;
    }
    return nullptr;
}

// What a step falls back to, and what font() returns for it when there is
// no vector font: the icon font, then the 16 px body fonts. Icons stay
// large; text drops to 16 px, as there is no large Latin bitmap font.
const lv_font_t* degraded(int step) {
    const lv_font_t* icons = icon_font(step);
    return icons != nullptr ? icons : default_font();
}

// Tiny TTF looks a character up in its glyph cache, and when the font has
// no glyph the cache entry cannot be created and Tiny TTF logs an LVGL
// error -- for every icon and every character outside the subset, on
// every measure and draw. Answering "not here" first lets LVGL move on to
// the fallback quietly. Tiny TTF answers control characters, U+200C and
// LV_SYMBOL_DUMMY itself (as empty glyphs) without the font; those still
// go to it.
bool vector_glyph_dsc(const lv_font_t* font, lv_font_glyph_dsc_t* dsc, uint32_t letter,
                      uint32_t letter_next) {
    const bool tiny_ttf_special = letter < 0x20 || letter == 0x200C || letter == 0xF8FF;
    if (!tiny_ttf_special && !font_image_has_glyph(s_image, letter)) return false;
    return s_tiny_ttf_glyph_dsc(font, dsc, letter, letter_next);
}

size_t step_index(int step) {
    return static_cast<size_t>(std::find(kFontSteps.begin(), kFontSteps.end(), step) -
                               kFontSteps.begin());
}

// A Tiny TTF font of `px` pixels from the installed image, with the
// lookup filter and line box below and no fallback; nullptr without an
// image or when Tiny TTF cannot create it. The caller owns it.
lv_font_t* create_tiny_ttf(int px) {
    if (s_image.ttf.empty()) return nullptr;
    lv_font_t* f = lv_tiny_ttf_create_data_ex(s_image.ttf.data(), s_image.ttf.size(), px,
                                              LV_FONT_KERNING_NORMAL, font_cache_entries(px));
    if (f == nullptr) {
        WLOG_W("ui", "fonts: cannot create the %d px vector font", px);
        return nullptr;
    }
    s_tiny_ttf_glyph_dsc = f->get_glyph_dsc;
    f->get_glyph_dsc = vector_glyph_dsc;
    // Tiny TTF sizes the line from hhea (1.448 em for Noto Sans CJK), much
    // taller than the bitmap fonts. The line box is set to -0.28..0.99 em
    // instead, which holds every glyph in the charset (spec 4.3): a
    // label clips its glyphs to its own text area, so ink outside the
    // line box would be cut off on the first and last lines. The base
    // line sits one row lower than that box implies because Tiny TTF
    // places each bitmap one row high (box_h = y2 - y1 + 1 with
    // ofs_y = -y2; the extra row is blank, at the bottom). The fields are
    // written directly: lv_tiny_ttf_set_size() would recompute them from
    // hhea.
    const int32_t descent = (28 * px + 99) / 100;  // ceil(0.28 * px)
    const int32_t ascent = (99 * px + 99) / 100;   // ceil(0.99 * px)
    f->line_height = descent + ascent;
    f->base_line = descent - 1;
    f->fallback = nullptr;
    return f;
}

const lv_font_t* create_vector(int step) {
    lv_font_t* f = create_tiny_ttf(step);
    if (f == nullptr) return degraded(step);
    s_vector[step_index(step)] = f;
    f->fallback = degraded(step);
    return f;
}

}  // namespace

int font_step(int px) {
    if (px < kVectorMinPx) return kBodyFontPx;
    int step = kFontSteps.front();
    for (int s : kFontSteps) {
        if (s <= px) step = s;
    }
    return step;
}

size_t font_cache_entries(int step) {
    // 131072 / (0.6 * step^2 + 250), in integers.
    const int64_t s = step;
    const int64_t entries = 1310720 / (6 * s * s + 2500);
    return static_cast<size_t>(std::clamp<int64_t>(entries, 8, 256));
}

const lv_font_t* font(int px) {
#ifndef NDEBUG
    // font() caches into plain tables and creates LVGL objects, so a call
    // from another thread while the UI runs would race the UI task.
    const os::Task* owner = s_owner.load(std::memory_order_acquire);
    assert(owner == nullptr || owner->is_current());
#endif
    const int step = font_step(px);
    if (step == kBodyFontPx) return default_font();
    const lv_font_t*& slot = s_fonts[step_index(step)];
    if (slot == nullptr) slot = create_vector(step);
    return slot;
}

bool vector_fonts_ready() { return !s_image.ttf.empty(); }

namespace detail {

void install_font_image(const FontImage* image) {
    s_image = image ? *image : FontImage{};
    // A step asked for while no runtime ran holds its bitmap fallback; it
    // would otherwise shadow the vector font for as long as this runtime
    // runs. Only bitmap fonts can be cached here: vector fonts exist only
    // between start() and stop(), and stop() forgets them.
    s_fonts.fill(nullptr);
}

void install_glyph_font(std::span<const uint8_t> raw, bool builtin_allowed) {
    auto opened = open_glyph_image(raw);
    if (opened) {
        // Validated, so the header's payload length is in range.
        const uint32_t payload = raw[8] | (uint32_t{raw[9]} << 8) | (uint32_t{raw[10]} << 16) |
                                 (uint32_t{raw[11]} << 24);
        WLOG_I("ui", "fonts: glyph image ok, %u bytes, crc %08x",
               static_cast<unsigned>(kGlyphImageHeaderBytes + payload),
               static_cast<unsigned>(opened.value()->crc32));
        set_cjk_fallback(&keep_glyph_font(raw, std::move(opened.value()))->font);
        return;
    }
    const char* why = opened.error().message.c_str();
    if (builtin_allowed && idle_cjk_fallback() != nullptr) {
        WLOG_W("ui", "fonts: %s; body text uses the built-in CJK font", why);
        set_cjk_fallback(idle_cjk_fallback());
        return;
    }
    // Spec 4.3: blurrier than the bitmap font, but readable. Its own
    // fallback stays empty: the body font falls back to it, and LVGL
    // would follow a loop back forever for a character neither has.
    s_body_vector = create_tiny_ttf(kBodyFontPx);
    if (s_body_vector != nullptr) {
        WLOG_W("ui", "fonts: %s; body text uses the 16 px vector font", why);
        set_cjk_fallback(s_body_vector);
        return;
    }
    WLOG_W("ui", "fonts: %s; body text has no CJK glyphs", why);
    set_cjk_fallback(nullptr);
}

void set_font_owner(const os::Task* task) { s_owner.store(task, std::memory_order_release); }

void release_vector_fonts() {
    // The runtime's CJK fallback goes with it: a glyph font's bytes need
    // only outlive the runtime, and the 16 px vector font is destroyed
    // below.
    set_cjk_fallback(idle_cjk_fallback());
    if (s_body_vector != nullptr) lv_tiny_ttf_destroy(s_body_vector);
    s_body_vector = nullptr;
    for (lv_font_t*& f : s_vector) {
        if (f != nullptr) lv_tiny_ttf_destroy(f);
        f = nullptr;
    }
    s_fonts.fill(nullptr);
    s_image = {};
}

}  // namespace detail

}  // namespace wisp::ui
