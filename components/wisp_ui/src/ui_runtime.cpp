#include "wisp/ui/ui_runtime.hpp"

// Sanity check: this translation unit must be compiled against wisp_ui's
// own components/wisp_ui/config/lv_conf.h (see AGENTS.md's "LVGL 配置"
// trap and cmake/wisp_host_deps.cmake's LV_BUILD_CONF_PATH wiring), not
// some other lv_conf.h LVGL happened to find via its __has_include probe.
#ifndef WISP_LV_CONF
#error "wisp lv_conf.h not in use"
#endif

static_assert(LV_COLOR_DEPTH == 16, "wisp_ui requires LV_COLOR_DEPTH == 16 (RGB565)");

#include <algorithm>
#include <atomic>
#include <cstring>
#include <deque>
#include <mutex>
#include <utility>

#include "a8_font.hpp"
#include "wisp/base/error.hpp"
#include "wisp/core/log.hpp"
#include "wisp/os/os.hpp"
#include "wisp/os/queue.hpp"
#include "wisp/ui/align.hpp"

// lv_font_cjk_16.c is a plain C translation unit (generated by
// tools/gen_cjk_font.py), so its one exported symbol
// has C linkage.
extern "C" {
extern const lv_font_t lv_font_cjk_16;
}

namespace wisp::ui {

namespace {

constexpr size_t kPostQueueCapacity = 32;
constexpr uint64_t kPerfWindowMs = 1000;

int cap_int(const wisp::Properties& caps, const char* key, int fallback) {
    auto it = caps.find(key);
    if (it == caps.end()) {
        return fallback;
    }
    return static_cast<int>(it->second.as_int());
}

void prune_frame_times(std::deque<uint64_t>& samples, uint64_t now) {
    uint64_t cutoff = now > kPerfWindowMs ? now - kPerfWindowMs : 0;
    while (!samples.empty() && samples.front() < cutoff) {
        samples.pop_front();
    }
}

// One frame's worth of flushes. Kept per frame rather than per stripe: a
// frame is a dozen or more stripes, and these deques live in internal RAM.
struct FlushSample {
    uint64_t ts_ms = 0;  // when the latest stripe was sent
    uint64_t total_us = 0;
    uint32_t stripes = 0;
    bool open = true;  // the frame's last stripe has not been sent yet
};

uint64_t sample_ts(const std::pair<uint64_t, uint32_t>& sample) { return sample.first; }
uint64_t sample_ts(const FlushSample& sample) { return sample.ts_ms; }

template <typename Sample>
void prune_duration_samples(std::deque<Sample>& samples, uint64_t now) {
    uint64_t cutoff = now > kPerfWindowMs ? now - kPerfWindowMs : 0;
    while (!samples.empty() && sample_ts(samples.front()) < cutoff) {
        samples.pop_front();
    }
}

}  // namespace

const lv_font_t* default_font() {
    // lv_font_montserrat_16 is `const`, so it can't be modified in place;
    // this is a mutable copy with `fallback` pointed at the CJK font.
    // Function-local static: lazily constructed exactly once (C++11 magic
    // statics are thread-safe), the first time anyone (UiRuntime::start()
    // or an outside caller, e.g. wisp_app's self-check UI) asks for it.
    static lv_font_t s_base = [] {
        lv_font_t font = lv_font_montserrat_16;
        font.fallback = &lv_font_cjk_16;
        return font;
    }();
    // Drawn from cached 8-bit glyphs rather than expanded on every draw
    // (see a8_font.hpp); pixels are the same.
    static const lv_font_t* s_ui_font = a8_font(&s_base);
    return s_ui_font;
}

struct UiRuntime::Impl {
    std::shared_ptr<hal::Display> display;
    std::shared_ptr<hal::Touch> touch;
    UiConfig config;

    os::Queue<std::function<void()>> post_queue{kPostQueueCapacity};
    std::unique_ptr<os::Task> task;
    std::atomic<bool> running{false};

    // on_ui_thread() reads this instead of `task` directly: `task` itself
    // (the unique_ptr) is only ever written by whichever thread calls
    // start()/stop(), with no synchronization against a concurrent reader
    // -- a real data race if on_ui_thread() dereferenced it directly. This
    // atomic mirror is written once, right after `task` is assigned in
    // start(), and cleared in stop() before `task` is reset, so every read
    // through it is race-free regardless of which thread is asking.
    std::atomic<os::Task*> active_task{nullptr};

    // os::Task::spawn() starts the new thread running ui_main() as part
    // of the spawn() call itself, so that thread can already be calling
    // into LVGL (and, through flush_cb()/etc., the Display) before
    // start() has finished storing `active_task` and installing the
    // Display's owner-thread check below -- both unsynchronized against
    // a concurrent reader on that thread otherwise (the active_task
    // store is atomic, so not a data race by itself, but still logically
    // too late; the owner-thread check is a plain std::function, so a
    // concurrent install and first read of it from the new thread *is*
    // a genuine data race). ui_main()'s very first action is to wait on
    // this; start() gives it only after both are fully set up, so
    // nothing on the UI thread runs until the handoff is complete.
    os::Semaphore ui_ready{1, 0};

    int width = 0;
    int height = 0;
    int area_align = 1;

    // Two partial draw buffers: LVGL renders into one while
    // Display::flush_async() sends the other (spec 6.4).
    void* buf[2] = {nullptr, nullptr};

    lv_display_t* lv_disp = nullptr;
    lv_indev_t* lv_indev = nullptr;

    // Mirrors whatever the sysmon overlay's hidden flag actually is,
    // written from inside the very lambda set_perf_overlay() posts (so it
    // reflects reality, not just "a call was requested") -- see
    // perf_overlay_enabled() below. Readable from any thread.
    std::atomic<bool> perf_overlay_enabled{false};

    // spec 6.7: set by set_paused(), read at the top of every
    // ui_main() loop iteration. Just an atomic flag -- see
    // UiRuntime::set_paused()'s doc comment for why that's enough (no
    // extra synchronization needed against stop(), post(), or the
    // normal lv_timer_handler() path).
    std::atomic<bool> paused{false};

    // Guards touch_activity_cb against a set_touch_activity_cb() call
    // racing indev_read_cb() reading/invoking it (both can happen from
    // any thread/the UI task respectively). Taken only briefly on each
    // side -- see indev_read_cb(), which copies the std::function out
    // under the lock and invokes the copy after releasing it, so a
    // reentrant call from inside the callback itself (e.g. back into
    // this UiRuntime) can't deadlock on it.
    os::Mutex touch_activity_mutex;
    std::function<void()> touch_activity_cb;

    // --- perf (protected by perf_mutex) ---
    mutable os::Mutex perf_mutex;
    uint32_t frames_total = 0;
    std::deque<uint64_t> frame_times;  // ms timestamps
    std::deque<FlushSample> flush_samples;
    std::deque<std::pair<uint64_t, uint32_t>> busy_samples;  // (ts_ms, duration_ms)

    void ui_main();
    void drain_post_queue();
    void record_busy(uint32_t duration_ms);
    void record_flush(uint32_t duration_us);
    void add_flush_wait(uint32_t duration_us);
    void free_buffers();
    void record_frame();
    Result<std::vector<uint8_t>> take_snapshot();

    static void flush_cb(lv_display_t* disp, const lv_area_t* area, uint8_t* px_map);
    static void flush_wait_cb(lv_display_t* disp);
    static void invalidate_area_cb(lv_event_t* e);
    static void indev_read_cb(lv_indev_t* indev, lv_indev_data_t* data);
};

void UiRuntime::Impl::drain_post_queue() {
    std::function<void()> fn;
    while (post_queue.pop(fn, 0)) {
        fn();
        fn = nullptr;  // release captured state before the next pop
    }
}

void UiRuntime::Impl::ui_main() {
    // Waits for start() to finish storing `active_task` and installing
    // the Display's owner-thread check (see ui_ready's doc comment)
    // before touching anything LVGL/Display-related below.
    ui_ready.take(os::kForever);

    // Tracks whether the *previous* iteration was in the paused branch
    // below, so the exact loop iteration where paused flips true->false
    // is detected here (on the UI task, the only place lv_* may be
    // called) and gets exactly one lv_obj_invalidate() -- see
    // UiRuntime::set_paused()'s doc comment.
    bool was_paused = false;

    while (running.load(std::memory_order_acquire)) {
        if (paused.load(std::memory_order_acquire)) {
            was_paused = true;
            // Blocks indefinitely waiting for post()'d work -- no LVGL
            // timer fires and no flush happens while paused, and no
            // periodic wake happens either: spec 6.7
            // requires standby to have "没有周期性的 UI 定时器，也没有
            // 高频轮询", so this must not poll on any fixed interval of
            // its own. A concurrent post() wakes this immediately
            // (Queue::push() signals the same semaphore pop() waits on);
            // stop() additionally pushes a no-op job after flipping
            // `running` to false specifically to wake a UI task that
            // might currently be blocked right here (see
            // UiRuntime::stop()) -- without that, a paused UI task would
            // never notice `running` went false until the next
            // post()'d job happened to arrive, which might be never.
            std::function<void()> fn;
            if (post_queue.pop(fn, os::kForever)) {
                fn();
                fn = nullptr;
            }
            continue;
        }
        if (was_paused) {
            // Just resumed: whatever was invalidated while paused was
            // never actually drawn (lv_timer_handler() never ran), so
            // force one full redraw now, before the normal loop below
            // resumes calling it.
            lv_obj_invalidate(lv_screen_active());
            was_paused = false;
        }

        uint64_t loop_start = os::now_ms();
        drain_post_queue();
        if (paused.load(std::memory_order_acquire)) {
            // A job drained just above may itself have called
            // set_paused(true) (e.g. PowerManager::enter_standby()
            // running entirely inside one post()'d job, right after some
            // other posted job dirtied a widget) -- the unconditional
            // lv_timer_handler() call below used to still run once more
            // on this same loop iteration, flushing whatever was dirty
            // against a display the caller already considers asleep.
            // The paused check at the top of this loop only takes effect
            // starting the *next* iteration, so it alone doesn't catch
            // this; skip straight back there instead of calling
            // lv_timer_handler() this time.
            continue;
        }
        uint32_t next_ms = lv_timer_handler();
        uint64_t loop_end = os::now_ms();
        record_busy(static_cast<uint32_t>(loop_end - loop_start));

        uint32_t sleep_ms = std::min<uint32_t>(next_ms, 10);
        os::sleep_ms(sleep_ms);
    }
    // stop() may have post()'d a final piece of work (or one may already
    // have been queued) right before flipping `running` to false; drain it
    // now so it still runs before the caller tears LVGL down.
    drain_post_queue();
}

void UiRuntime::Impl::record_busy(uint32_t duration_ms) {
    uint64_t now = os::now_ms();
    std::lock_guard<os::Mutex> lock(perf_mutex);
    busy_samples.emplace_back(now, duration_ms);
    prune_duration_samples(busy_samples, now);
}

void UiRuntime::Impl::record_flush(uint32_t duration_us) {
    uint64_t now = os::now_ms();
    std::lock_guard<os::Mutex> lock(perf_mutex);
    if (flush_samples.empty() || !flush_samples.back().open) {
        flush_samples.emplace_back();
    }
    FlushSample& frame = flush_samples.back();
    frame.ts_ms = now;
    frame.total_us += duration_us;
    ++frame.stripes;
    prune_duration_samples(flush_samples, now);
}

// The wait belongs to the transfer started by the previous flush_cb(),
// whose frame is the newest sample.
void UiRuntime::Impl::add_flush_wait(uint32_t duration_us) {
    std::lock_guard<os::Mutex> lock(perf_mutex);
    if (!flush_samples.empty()) {
        flush_samples.back().total_us += duration_us;
    }
}

void UiRuntime::Impl::free_buffers() {
    for (void*& b : buf) {
        os::dealloc(b);
        b = nullptr;
    }
}

void UiRuntime::Impl::record_frame() {
    uint64_t now = os::now_ms();
    std::lock_guard<os::Mutex> lock(perf_mutex);
    ++frames_total;
    if (!flush_samples.empty()) {
        flush_samples.back().open = false;
    }
    frame_times.push_back(now);
    prune_frame_times(frame_times, now);
}

Result<std::vector<uint8_t>> UiRuntime::Impl::take_snapshot() {
    lv_draw_buf_t* buf = lv_snapshot_take(lv_screen_active(), LV_COLOR_FORMAT_RGB888);
    if (buf == nullptr) {
        return Result<std::vector<uint8_t>>::err(ErrorCode::DeviceFailure,
                                                 "lv_snapshot_take failed");
    }

    size_t row_bytes = static_cast<size_t>(width) * 3;
    std::vector<uint8_t> out(row_bytes * static_cast<size_t>(height));
    for (int y = 0; y < height; ++y) {
        const uint8_t* src = buf->data + static_cast<size_t>(y) * buf->header.stride;
        uint8_t* dst = out.data() + static_cast<size_t>(y) * row_bytes;
        for (int x = 0; x < width; ++x) {
            // LVGL's LV_COLOR_FORMAT_RGB888 draw buffers store each pixel
            // as (blue, green, red) -- see lv_color_t in lv_color.h and
            // the fill loop in lv_draw_sw_blend_to_rgb888.c -- but this
            // function is documented (and tested) to return (R, G, B).
            dst[x * 3 + 0] = src[x * 3 + 2];  // R
            dst[x * 3 + 1] = src[x * 3 + 1];  // G
            dst[x * 3 + 2] = src[x * 3 + 0];  // B
        }
    }

    lv_draw_buf_destroy(buf);

    // Cards and dialogs sit on the top layer, which lv_snapshot_take() of
    // the screen leaves out; blend it on so the snapshot shows what the
    // panel shows. Skipped when empty, the common case.
    lv_obj_t* top = lv_layer_top();
    if (top != nullptr && lv_obj_get_child_count(top) > 0) {
        lv_draw_buf_t* overlay = lv_snapshot_take(top, LV_COLOR_FORMAT_ARGB8888);
        if (overlay == nullptr) {
            return Result<std::vector<uint8_t>>::err(ErrorCode::DeviceFailure,
                                                     "lv_snapshot_take(top layer) failed");
        }
        const int ow = std::min<int>(overlay->header.w, width);
        const int oh = std::min<int>(overlay->header.h, height);
        for (int y = 0; y < oh; ++y) {
            const uint8_t* src = overlay->data + static_cast<size_t>(y) * overlay->header.stride;
            uint8_t* dst = out.data() + static_cast<size_t>(y) * row_bytes;
            for (int x = 0; x < ow; ++x) {
                // ARGB8888 is stored as (B, G, R, A), like RGB888 above.
                const uint32_t a = src[x * 4 + 3];
                if (a == 0) continue;
                for (int c = 0; c < 3; ++c) {
                    const uint32_t over = src[x * 4 + 2 - c];
                    uint8_t& under = dst[x * 3 + c];
                    under = static_cast<uint8_t>((over * a + under * (255 - a) + 127) / 255);
                }
            }
        }
        lv_draw_buf_destroy(overlay);
    }
    return Result<std::vector<uint8_t>>::ok(std::move(out));
}

// Starts the transfer and returns without lv_display_flush_ready(): LVGL
// keeps rendering into the other buffer and calls flush_wait_cb() before it
// needs this one again or hands over the next stripe. A failed flush_async()
// sent nothing, so its wait_flush() returns at once.
void UiRuntime::Impl::flush_cb(lv_display_t* disp, const lv_area_t* area, uint8_t* px_map) {
    auto* impl = static_cast<Impl*>(lv_display_get_user_data(disp));
    hal::Area hal_area{area->x1, area->y1, area->x2, area->y2};

    uint64_t t0 = os::now_us();
    impl->display->flush_async(hal_area, reinterpret_cast<const uint16_t*>(px_map));
    impl->record_flush(static_cast<uint32_t>(os::now_us() - t0));

    if (lv_display_flush_is_last(disp)) {
        impl->record_frame();
    }
}

// LVGL marks the buffer free itself once this returns.
void UiRuntime::Impl::flush_wait_cb(lv_display_t* disp) {
    auto* impl = static_cast<Impl*>(lv_display_get_user_data(disp));
    uint64_t t0 = os::now_us();
    impl->display->wait_flush();
    impl->add_flush_wait(static_cast<uint32_t>(os::now_us() - t0));
}

void UiRuntime::Impl::invalidate_area_cb(lv_event_t* e) {
    auto* impl = static_cast<Impl*>(lv_event_get_user_data(e));
    lv_area_t* area = lv_event_get_invalidated_area(e);

    hal::Area in{area->x1, area->y1, area->x2, area->y2};
    hal::Area aligned = align_area(in, impl->area_align, impl->width, impl->height);

    area->x1 = aligned.x1;
    area->y1 = aligned.y1;
    area->x2 = aligned.x2;
    area->y2 = aligned.y2;
}

void UiRuntime::Impl::indev_read_cb(lv_indev_t* indev, lv_indev_data_t* data) {
    auto* impl = static_cast<Impl*>(lv_indev_get_user_data(indev));
    auto points = impl->touch->read();
    if (points && !points.value().empty()) {
        const hal::TouchPoint& pt = points.value().front();
        data->point.x = pt.x;
        data->point.y = pt.y;
        data->state = LV_INDEV_STATE_PRESSED;

        std::function<void()> cb;
        {
            std::lock_guard<os::Mutex> lock(impl->touch_activity_mutex);
            cb = impl->touch_activity_cb;
        }
        if (cb) {
            cb();
        }
    } else {
        data->state = LV_INDEV_STATE_RELEASED;
    }
}

UiRuntime::UiRuntime(std::shared_ptr<hal::Display> display, std::shared_ptr<hal::Touch> touch,
                     UiConfig config)
    : impl_(std::make_unique<Impl>()) {
    impl_->display = std::move(display);
    impl_->touch = std::move(touch);
    impl_->config = config;
}

UiRuntime::~UiRuntime() { stop(); }

Result<void> UiRuntime::start() {
    if (impl_->running.load()) {
        return Result<void>::err(ErrorCode::AlreadyExists, "UiRuntime already started");
    }
    if (!impl_->display) {
        return Result<void>::err(ErrorCode::InvalidArgument, "display must not be null");
    }
    if (lv_is_initialized()) {
        WLOG_W("ui", "lv_init() already active; a previous UiRuntime was not stopped");
        return Result<void>::err(
            ErrorCode::Busy, "LVGL is already initialized by another UiRuntime in this process");
    }

    const wisp::Properties& caps = impl_->display->info().caps;
    impl_->width = cap_int(caps, "width", 0);
    impl_->height = cap_int(caps, "height", 0);
    impl_->area_align = cap_int(caps, "area_align", 1);
    auto be_it = caps.find("rgb565_be");
    const bool rgb565_be = be_it != caps.end() && be_it->second.as_bool();
    if (impl_->width <= 0 || impl_->height <= 0) {
        return Result<void>::err(ErrorCode::InvalidArgument,
                                 "display caps missing a usable width/height");
    }

    size_t buf_bytes = static_cast<size_t>(impl_->width) * impl_->config.buffer_lines * 2;
    for (void*& b : impl_->buf) {
        b = os::alloc(buf_bytes, os::Mem::Dma);
        if (b == nullptr) {
            impl_->free_buffers();
            return Result<void>::err(ErrorCode::NoMemory,
                                     "failed to allocate the LVGL draw buffers");
        }
    }

    lv_init();
    lv_tick_set_cb([]() -> uint32_t { return static_cast<uint32_t>(os::now_ms()); });
    lv_log_register_print_cb([](lv_log_level_t level, const char* buf) {
        (void)level;
        // LVGL's print callback hands us a line that already ends in
        // '\n' (sometimes "\r\n"); trim it so WLOG_I doesn't produce a
        // blank line underneath every LVGL log message.
        size_t len = std::strlen(buf);
        while (len > 0 && (buf[len - 1] == '\n' || buf[len - 1] == '\r')) {
            --len;
        }
        WLOG_I("lvgl", "%.*s", static_cast<int>(len), buf);
    });

    // Tears down everything lv_init() above (and whatever ran before this
    // point in start()) set up, for a failure partway through the rest of
    // setup below.
    auto fail_after_lv_init = [this](ErrorCode code, const char* message) {
        lv_deinit();
        impl_->lv_disp = nullptr;
        impl_->lv_indev = nullptr;
        impl_->free_buffers();
        return Result<void>::err(code, message);
    };

    impl_->lv_disp = lv_display_create(impl_->width, impl_->height);
    if (impl_->lv_disp == nullptr) {
        return fail_after_lv_init(ErrorCode::NoMemory, "lv_display_create failed");
    }
    lv_display_set_user_data(impl_->lv_disp, impl_.get());
    // Rendering straight into the panel's byte order costs nothing; swapping
    // each stripe afterwards would cost CPU time on every frame.
    lv_display_set_color_format(
        impl_->lv_disp, rgb565_be ? LV_COLOR_FORMAT_RGB565_SWAPPED : LV_COLOR_FORMAT_RGB565);
    lv_display_set_buffers(impl_->lv_disp, impl_->buf[0], impl_->buf[1],
                           static_cast<uint32_t>(buf_bytes), LV_DISPLAY_RENDER_MODE_PARTIAL);
    lv_display_set_flush_cb(impl_->lv_disp, &Impl::flush_cb);
    lv_display_set_flush_wait_cb(impl_->lv_disp, &Impl::flush_wait_cb);
    lv_display_add_event_cb(impl_->lv_disp, &Impl::invalidate_area_cb, LV_EVENT_INVALIDATE_AREA,
                            impl_.get());
    lv_display_set_default(impl_->lv_disp);

    // lv_display_create() itself calls lv_sysmon_show_performance() when
    // LV_USE_PERF_MONITOR is on (see src/display/lv_display.c), so the
    // overlay is visible the moment the display exists -- undo that here
    // so it starts hidden, as lv_conf.h's comment promises; the label it
    // just created stays around, so later show/hide calls (from
    // set_perf_overlay()) can use it unconditionally.
    lv_sysmon_hide_performance(impl_->lv_disp);

    lv_theme_t* theme =
        lv_theme_default_init(impl_->lv_disp, lv_palette_main(LV_PALETTE_BLUE),
                              lv_palette_main(LV_PALETTE_RED), false, default_font());
    lv_display_set_theme(impl_->lv_disp, theme);
    // The theme applies its font only to screens, so widgets on the top
    // and system layers (dialogs, overlays) would otherwise fall back to
    // LV_FONT_DEFAULT, which has no CJK glyphs.
    lv_obj_set_style_text_font(lv_display_get_layer_top(impl_->lv_disp), default_font(), 0);
    lv_obj_set_style_text_font(lv_display_get_layer_sys(impl_->lv_disp), default_font(), 0);

    if (impl_->touch) {
        impl_->lv_indev = lv_indev_create();
        if (impl_->lv_indev == nullptr) {
            return fail_after_lv_init(ErrorCode::NoMemory, "lv_indev_create failed");
        }
        lv_indev_set_type(impl_->lv_indev, LV_INDEV_TYPE_POINTER);
        lv_indev_set_display(impl_->lv_indev, impl_->lv_disp);
        lv_indev_set_user_data(impl_->lv_indev, impl_.get());
        lv_indev_set_read_cb(impl_->lv_indev, &Impl::indev_read_cb);
    }

    impl_->running.store(true, std::memory_order_release);
    os::TaskConfig task_config;
    task_config.name = "wisp_ui";
    task_config.stack_bytes = impl_->config.task_stack;
    task_config.priority = impl_->config.task_priority;
    Impl* impl = impl_.get();
    impl_->task = os::Task::spawn(task_config, [impl] { impl->ui_main(); });
    if (impl_->task == nullptr) {
        // Must not fall through to installing the owner-thread check or
        // giving ui_ready below: with no task, active_task stays null,
        // on_ui_thread() would then permanently return false, and every
        // subsequent Display call (from any thread, including a headless
        // fallback's own cleanup) would trip assert_owner_thread() (see
        // display.hpp) instead of this start() call simply failing.
        impl_->running.store(false, std::memory_order_release);
        return fail_after_lv_init(ErrorCode::NoMemory, "failed to spawn UI task");
    }
    impl_->active_task.store(impl_->task.get(), std::memory_order_release);

    // spec 5.3: now that the UI task exists, every further Display call
    // must come from it (debug-build assertion; see display.hpp).
    impl_->display->set_owner_thread_check([this] { return on_ui_thread(); });

    // Only now may the UI task (already running, blocked on this since
    // before either store above) actually proceed -- see ui_ready's doc
    // comment on Impl.
    impl_->ui_ready.give();

    return Result<void>::ok();
}

void UiRuntime::stop() {
    if (on_ui_thread()) {
        // task->join() below would be a self-join (deadlock): the UI task
        // can't wait for itself to finish. There's no safe way to honor
        // this call from here, so refuse it instead of hanging.
        WLOG_E("ui", "UiRuntime::stop() called from the UI task itself; ignoring");
        return;
    }
    if (!impl_->running.exchange(false, std::memory_order_acq_rel)) {
        return;
    }
    // ui_main()'s paused branch blocks forever (os::kForever) waiting
    // for post()'d work, rather than polling every kPausedPollMs --
    // so if the UI task happens to be paused and
    // sitting in that wait right now, it will never notice `running`
    // just went false on its own. Push a no-op to wake it; if the queue
    // is already full, there is pending work that will wake it on its
    // own (either way, join() below will see it exit promptly).
    impl_->post_queue.push([] {}, 0);
    if (impl_->task) {
        impl_->task->join();
    }
    impl_->active_task.store(nullptr, std::memory_order_release);
    impl_->task.reset();

    // The check installed in start() captures `this`, which must not
    // outlive this UiRuntime -- the Display itself usually does (it's
    // owned by the board/platform, not by UiRuntime). Clear it now that
    // no further Display call from the UI task is possible.
    impl_->display->set_owner_thread_check(nullptr);

    // The UI task has fully exited: no further lv_* call is in flight, so
    // tearing LVGL down now is safe. The last stripe may still be on the
    // wire, so wait for it before freeing its buffer.
    impl_->display->wait_flush();
    lv_deinit();
    impl_->lv_disp = nullptr;
    impl_->lv_indev = nullptr;

    impl_->free_buffers();
}

bool UiRuntime::post(std::function<void()> fn) { return impl_->post_queue.push(std::move(fn), 0); }

bool UiRuntime::on_ui_thread() const {
    os::Task* task = impl_->active_task.load(std::memory_order_acquire);
    return task != nullptr && task->is_current();
}

void UiRuntime::set_paused(bool paused) {
    bool was_paused = impl_->paused.exchange(paused, std::memory_order_acq_rel);
    // ui_main()'s paused branch blocks forever (os::kForever) waiting
    // for post()'d work, rather than polling -- so unpausing (paused:
    // true -> false) must itself wake a UI task
    // that might be sitting in that wait right now, or it would never
    // notice `paused` went false until some *other* post()'d job
    // happened to arrive on its own. Only needed on an actual true->
    // false transition (not a redundant set_paused(false) while already
    // unpaused, nor set_paused(true), which doesn't need waking
    // anything up). If the queue is already full, there is pending work
    // that will wake it on its own either way.
    if (was_paused && !paused) {
        impl_->post_queue.push([] {}, 0);
    }
}

bool UiRuntime::paused() const { return impl_->paused.load(std::memory_order_acquire); }

void UiRuntime::set_touch_activity_cb(std::function<void()> cb) {
    std::lock_guard<os::Mutex> lock(impl_->touch_activity_mutex);
    impl_->touch_activity_cb = std::move(cb);
}

Result<std::vector<uint8_t>> UiRuntime::snapshot_rgb888(uint32_t timeout_ms) {
    if (on_ui_thread()) {
        // Posting-and-blocking here would deadlock: the posted lambda can
        // only run once this same UI task reaches its next
        // drain_post_queue() call, which can't happen while this call is
        // still blocked waiting for it. Just take the snapshot directly.
        return impl_->take_snapshot();
    }

    struct SnapshotState {
        os::Semaphore done{1, 0};
        Result<std::vector<uint8_t>> result =
            Result<std::vector<uint8_t>>::err(ErrorCode::Timeout, "snapshot did not complete");
    };
    auto state = std::make_shared<SnapshotState>();
    Impl* impl = impl_.get();

    bool posted = post([impl, state] {
        state->result = impl->take_snapshot();
        state->done.give();
    });
    if (!posted) {
        return Result<std::vector<uint8_t>>::err(ErrorCode::Busy, "UI post queue full");
    }
    if (!state->done.take(timeout_ms)) {
        return Result<std::vector<uint8_t>>::err(ErrorCode::Timeout, "snapshot timed out");
    }
    return state->result;
}

UiPerf UiRuntime::perf() const {
    uint64_t now = os::now_ms();
    std::lock_guard<os::Mutex> lock(impl_->perf_mutex);

    prune_frame_times(impl_->frame_times, now);
    prune_duration_samples(impl_->flush_samples, now);
    prune_duration_samples(impl_->busy_samples, now);

    UiPerf p;
    p.frames = impl_->frames_total;

    // spec 6.7: while paused, ui_main() never runs
    // lv_timer_handler()/flush_cb(), so busy_samples/flush_samples
    // simply decay to empty (and frame_times stop growing) as the 1s
    // window slides past the last real activity -- fps/cpu_percent/
    // avg_flush_ms would eventually read 0 on their own, but only after
    // up to kPerfWindowMs of a stale, decaying reading in the meantime.
    // Reporting the window as empty immediately instead avoids ever
    // showing a bogus non-zero FPS/CPU% for a UI that is not currently
    // rendering at all. `frames` is a lifetime total (see UiPerf's doc
    // comment), so it is reported as-is either way.
    if (impl_->paused.load(std::memory_order_acquire)) {
        return p;
    }
    // The window is exactly kPerfWindowMs (1s) by construction, so the
    // frame count already *is* the rate (frames per second).
    p.fps = static_cast<float>(impl_->frame_times.size());

    uint32_t busy_total_ms = 0;
    for (const auto& sample : impl_->busy_samples) {
        busy_total_ms += sample.second;
    }
    float cpu = static_cast<float>(busy_total_ms) / static_cast<float>(kPerfWindowMs) * 100.0f;
    cpu = std::max(0.0f, std::min(100.0f, cpu));
    p.cpu_percent = static_cast<uint8_t>(cpu + 0.5f);

    uint64_t flush_total_us = 0;
    uint32_t stripes = 0;
    for (const auto& sample : impl_->flush_samples) {
        flush_total_us += sample.total_us;
        stripes += sample.stripes;
    }
    if (stripes > 0) {
        p.avg_flush_ms = static_cast<float>(flush_total_us) / 1000.0f / static_cast<float>(stripes);
    }

    return p;
}

void UiRuntime::set_perf_overlay(bool enabled) {
    // The sysmon label already exists by the time start() returns (see
    // the lv_sysmon_hide_performance() call there), so both of these are
    // always safe to call unconditionally.
    Impl* impl = impl_.get();
    post([impl, enabled] {
        if (enabled) {
            lv_sysmon_show_performance(impl->lv_disp);
        } else {
            lv_sysmon_hide_performance(impl->lv_disp);
        }
        // Written here (inside the posted lambda, after the LVGL call
        // above has actually run), not synchronously in set_perf_overlay()
        // itself -- a caller of perf_overlay_enabled() right after
        // set_perf_overlay() returns is asking "has it taken effect yet",
        // not "was it requested".
        impl->perf_overlay_enabled.store(enabled, std::memory_order_release);
    });
}

bool UiRuntime::perf_overlay_enabled() const {
    return impl_->perf_overlay_enabled.load(std::memory_order_acquire);
}

}  // namespace wisp::ui
